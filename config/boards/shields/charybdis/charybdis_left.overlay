/*
 * Copyright (c) 2020 ZMK Contributors
 *
 * SPDX-License-Identifier: MIT
 */

#include "charybdis.dtsi"

// nice!nano v2 enables its switched VCC rail with P0.13 high.
// Default off at boot; Studio's nano35_left_vcc_enabled setting can override it.
&{/EXT_POWER} {
    status = "disabled";
};

&gpio0 {
    vcc_boot_off {
        gpio-hog;
        gpios = <13 GPIO_ACTIVE_HIGH>;
        output-low;
    };
};

&kscan0 {
	col-gpios
		= <&gpio0 2 (GPIO_ACTIVE_HIGH | GPIO_PULL_DOWN)>
		, <&gpio0 29 (GPIO_ACTIVE_HIGH | GPIO_PULL_DOWN)>
		, <&gpio0 9 (GPIO_ACTIVE_HIGH | GPIO_PULL_DOWN)>
		, <&gpio1 0  (GPIO_ACTIVE_HIGH | GPIO_PULL_DOWN)>
		, <&gpio0 11 (GPIO_ACTIVE_HIGH | GPIO_PULL_DOWN)>

		;
};
